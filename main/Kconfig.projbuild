## main/Kconfig.projbuild
```kconfig
menu "s3_module_lab"

    config LAB_VOICE_DOWNLOAD_AUDIO
        bool "Embed audio/0001.wav and enable voice file download"
        default n
        help
            Embeds main/audio/0001.wav (about 94 KiB) into the app and enables
            the `voice download [f1|f6]` shell command, which writes the file to
            the WT2003Hx module over UART using its remote-download protocol
            (F1/F6 create file, FD size, F0 data packets).

            Keep this disabled for normal development so the app image stays
            small and `idf.py flash` does not rewrite the audio.

    config LAB_BLE_FOB_NAME
        string "BLE fob advertising name (normal commands)"
        default "S3-FOB"
        help
            Exact local name the central matches for normal fob commands.
            The fob advertises it in the scan response.

    config LAB_BLE_FOB_PAIR_NAME
        string "BLE fob pairing-window advertising name"
        default "S3-FOB-PAIR"
        help
            Exact local name the central matches only while the user has
            opened the host pairing window with KEY3 long-press or `ble pair`.

    config LAB_BLE_SMOKE_NAME
        string "BLE smoke advertising name"
        default "s3-smoke"

    config LAB_BLE_SCAN_ACTIVE
        bool "Use active BLE scan (send SCAN_REQ)"
        default y
        help
            Active scan also receives scan responses. Disable only if both
            peripherals put their names in the advertising PDU.

    config LAB_BLE_SMOKE_HOOK
        bool "Bench hook: smoke notify first byte != 0 = smoke alarm"
        default n
        help
            Temporary mapping only. s3-smoke has no assigned GATT UUID or
            binary protocol yet. The hook sets the alarm smoke flag, which is
            OR-ed with the radar/panic condition while armed.

endmenu
```

## sdkconfig.defaults
```kconfig
CONFIG_IDF_TARGET="esp32s3"
CONFIG_ESP_CONSOLE_UART_DEFAULT=y
CONFIG_ESP_CONSOLE_UART_BAUDRATE=115200
CONFIG_ESP_CONSOLE_SECONDARY_NONE=y

# BLE central (NimBLE, two connections, SW coex off; Wi-Fi linked but unused)
CONFIG_BT_ENABLED=y
CONFIG_BT_NIMBLE_ENABLED=y
CONFIG_BT_BLUEDROID_ENABLED=n
CONFIG_BT_CONTROLLER_ENABLED=y
CONFIG_BT_CTRL_HCI_MODE_VHCI=y
CONFIG_BT_CTRL_BLE_MAX_ACT=3
CONFIG_BT_CTRL_PINNED_TO_CORE_0=y
# CONFIG_BT_CTRL_LE_LOG_EN is not set
CONFIG_BT_NIMBLE_ROLE_CENTRAL=y
# CONFIG_BT_NIMBLE_ROLE_PERIPHERAL is not set
# CONFIG_BT_NIMBLE_ROLE_BROADCASTER is not set
# CONFIG_BT_NIMBLE_ROLE_OBSERVER is not set
CONFIG_BT_NIMBLE_GATT_CLIENT=y
# CONFIG_BT_NIMBLE_GATT_SERVER is not set
CONFIG_BT_NIMBLE_MAX_CONNECTIONS=2
CONFIG_BT_NIMBLE_GATT_MAX_PROCS=6
CONFIG_BT_NIMBLE_SECURITY_ENABLE=y
CONFIG_BT_NIMBLE_SM_SC=y
CONFIG_BT_NIMBLE_NVS_PERSIST=y
CONFIG_BT_NIMBLE_MAX_BONDS=4
CONFIG_BT_NIMBLE_HOST_TASK_STACK_SIZE=4096
CONFIG_BT_NIMBLE_PINNED_TO_CORE_0=y
CONFIG_BT_NIMBLE_LOG_LEVEL_WARNING=y
# CONFIG_BT_NIMBLE_EXT_ADV is not set
# CONFIG_ESP_COEX_SW_COEXIST_ENABLE is not set
```
